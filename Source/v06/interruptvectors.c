
#include "interruptvectors.h"

#ifndef F_CPU
#define F_CPU 2000000UL
#endif

#include <avr/interrupt.h>
#include "usart.h"

extern uint8_t nReceivedBytes;
extern char  usartBuffer[USART_BUFFER_LENGHT];
extern uint8_t flagNewMessage;

/************************************************************************/
/* @Clear Buffer                                                        */
/************************************************************************/
void clearBuffer(void){
	uint8_t i;
	for(i=0; i< USART_BUFFER_LENGHT; i++) usartBuffer[i]=0;

}

/************************************************************************/
/* INTERRUPT HANDLER ACCORDING 128 MANUAL ORDER                                                                     */
/************************************************************************/




/************************************************************************/
/* EXTERNAL INTERRUPTS                                                                     */
/************************************************************************/

/************************************************************************/
/* handler External Interrupt Request 0                                                                     */
/************************************************************************/
ISR(INT0_vect){
	
}


/************************************************************************/
/* handler External Interrupt Request 1                                                                   */
/************************************************************************/
ISR(INT1_vect){
	
}


/************************************************************************/
/* handler External Interrupt Request 2                                                                    */
/************************************************************************/
ISR(INT2_vect){
	
}


/************************************************************************/
/* handler External Interrupt Request 3                                                                    */
/************************************************************************/
ISR(INT3_vect){
	
}


/************************************************************************/
/* handler External Interrupt Request 4                                                                   */
/************************************************************************/
ISR(INT4_vect){
	
}

/************************************************************************/
/* handler External Interrupt Request 5                                                                    */
/************************************************************************/
ISR(INT5_vect){
	
}


/************************************************************************/
/* handler External Interrupt Request 6                                                                  */
/************************************************************************/
ISR(INT6_vect){
	
}


/************************************************************************/
/* handler External Interrupt Request 7                                                                   */
/************************************************************************/
ISR(INT7_vect){
	
}




/************************************************************************/
/* TIMER INTERRUPTS                                                                   */
/************************************************************************/

/************************************************************************/
/* handler Timer/Counter2 Compare Match                                                                  */
/************************************************************************/
ISR(TIMER2_COMP_vect){
	
}


/************************************************************************/
/* handler Timer/Counter2 Overflow                                                                 */
/************************************************************************/
ISR(TIMER2_OVF_vect){
	
}


/************************************************************************/
/* handler Timer/Counter1 Capture Event                                                               */
/************************************************************************/
ISR(TIMER1_CAPT_vect){
	
}


/************************************************************************/
/* handler Timer/Counter1 Compare Match A                                                              */
/************************************************************************/
ISR(TIMER1_COMPA_vect){
	
}


/************************************************************************/
/* handler Timer/Counter1 Compare Match B                                                             */
/************************************************************************/
ISR(TIMER1_COMPB_vect){
	
}


/************************************************************************/
/* handler Timer/Counter1 Overflow                                                            */
/************************************************************************/
ISR(TIMER1_OVF_vect){
	
}


/************************************************************************/
/* handler Timer/Counter0 Compare Match                                                           */
/************************************************************************/
ISR(TIMER0_COMP_vect){
	
}



/************************************************************************/
/* handler Timer/Counter0 Overflow                                                          */
/************************************************************************/
ISR(TIMER0_OVF_vect){
	
}



/************************************************************************/
/* SERIALS INTERRUPT                                                                   */
/************************************************************************/

/************************************************************************/
/* handler SPI Serial Transfer Complete                                                         */
/************************************************************************/
ISR(SPI_STC_vect){
	
}


/************************************************************************/
/* handler USART0, Rx Complete                                                        */
/************************************************************************/
ISR(USART0_RX_vect){
	char c;
	c =USART0_receiveChar();
	// manda caracter para usart 0
	USART1_sendChar(c);
}


/************************************************************************/
/* handler USART0 Data Register Empty                                                       */
/************************************************************************/
ISR(USART0_UDRE_vect){

}


/************************************************************************/
/* handler USART0, Tx Complete                                                       */
/************************************************************************/
ISR(USART0_TX_vect){

}





/************************************************************************/
/* ANALOG CONVERTER                                                                   */
/************************************************************************/

/************************************************************************/
/* handler ADC Conversion Complete                                                    */
/************************************************************************/
ISR(ADC_vect){

}




/************************************************************************/
/* EEPROM                                                                   */
/************************************************************************/

/************************************************************************/
/* handler EEPROM Ready                                                   */
/************************************************************************/
ISR(EE_READY_vect){

}


/************************************************************************/
/* ANALOG COMPARATOR                                                                   */
/************************************************************************/

/************************************************************************/
/* handler Analog Comparator                                                  */
/************************************************************************/
ISR(ANALOG_COMP_vect){

}



/************************************************************************/
/* TIMER INTERRUPTS                                                                */
/************************************************************************/

/************************************************************************/
/* handler  Timer/Counter1 Compare Match C                                               */
/************************************************************************/
ISR(TIMER1_COMPC_vect){

}


/************************************************************************/
/* handler Timer/Counter3 Capture Event                                             */
/************************************************************************/
ISR(TIMER3_CAPT_vect){

}


/************************************************************************/
/* handler Timer/Counter3 Compare Match A                                             */
/************************************************************************/
ISR(TIMER3_COMPA_vect){

}


/************************************************************************/
/* handler Timer/Counter3 Compare Match B                                             */
/************************************************************************/
ISR(TIMER3_COMPB_vect){

}


/************************************************************************/
/* handler Timer/Counter3 Compare Match C                                           */
/************************************************************************/
ISR(TIMER3_COMPC_vect){

}


/************************************************************************/
/* handler Timer/Counter3 Overflow                                           */
/************************************************************************/
ISR(TIMER3_OVF_vect){

}




/************************************************************************/
/* SERIAL INTERRUPTS                                                                */
/************************************************************************/

/************************************************************************/
/* handler USART1, Rx Complete                                                                    */
/************************************************************************/
ISR(USART1_RX_vect){
	char c;

	
	c =USART1_receiveChar();
	USART0_sendChar(c); // reply with received char
	usartBuffer[nReceivedBytes]=c;
	nReceivedBytes++;
	
	if(c== '!'){
		nReceivedBytes=0;
		flagNewMessage=1;
		return;
	}
	
	if(nReceivedBytes> USART_BUFFER_LENGHT+1){
		nReceivedBytes=0;
		clearBuffer();
	}
}


/************************************************************************/
/* handler USART1 Data Register Empty                                          */
/************************************************************************/
ISR(USART1_UDRE_vect){

}


/************************************************************************/
/* handler USART1, Tx Complete                                         */
/************************************************************************/
ISR(USART1_TX_vect){

}


/************************************************************************/
/* handler Two-wire Serial Interface                                       */
/************************************************************************/
ISR(TWI_vect){

}


/************************************************************************/
/* handler Store Program Memory Ready                                       */
/************************************************************************/
ISR(SPM_READY_vect){

}

